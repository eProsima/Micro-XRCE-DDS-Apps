## Nuttx/examples/microxrceclient/Kconfig
```kconfig
#
# For a description of the syntax of this configuration file,
# see the file kconfig-language.txt in the NuttX tools repository.
#

config EXAMPLES_CLIENT
	bool "Micro XRCE-DDS example"
	default n
	depends on MICRO_XRCE_CLIENT
	---help---
		Enable the Micro XRCE-DDS Client example

if EXAMPLES_CLIENT

config EXAMPLES_CLIENT_PROGNAME
	string "Program name"
	default "client"
	depends on BUILD_KERNEL
	---help---
		This is the name of the program that will be use when the NSH ELF
		program is installed.

config EXAMPLES_CLIENT_PRIORITY
	int "Client task priority"
	default 100

config EXAMPLES_CLIENT_STACKSIZE
	int "Client stack size"
	default 4096

endif
```

## Nuttx/microxrcedds_demo_app/Kconfig
```kconfig
#
# For a description of the syntax of this configuration file,
# see the file kconfig-language.txt in the NuttX tools repository.
#

config MICRO_XRCE_CLIENT_DEMO_APP
	tristate "Micro XRCE-DDS example"
	default y
	depends on MICRO_XRCE_CLIENT
	---help---
		Enable the Micro XRCE-DDS example

config MICRO_XRCE_APP_STACKSIZE
	int "Micro XRCE demo stack size"
	default 4000
	depends on MICRO_XRCE_CLIENT_DEMO_APP
```

## Zephyr/modules/libmicroxrcedds/Kconfig
```kconfig
menuconfig MICROXRCEDDSCLIENT
    bool
	default y
    prompt "Micro XRCE-DDS Client Support"
    select APP_LINK_WITH_MICROXRCEDDSCLIENT
    help
        Enables Micro XRCE-DDS Client library

if MICROXRCEDDSCLIENT
    config APP_LINK_WITH_MICROXRCEDDSCLIENT
        bool "Link 'app' with MICROXRCEDDSCLIENT"
        default n
        help
            Add MICROXRCEDDSCLIENT header files to the 'app' include path. 
   
    # choice
    #     prompt "micro-ROS transport"
        
    #     config MICROXRCEDDSCLIENT_TRANSPORT_SERIAL
    #         bool "micro-ROS serial transport"
        
    #     config MICROXRCEDDSCLIENT_TRANSPORT_SERIAL_USB
    #         bool "micro-ROS USB serial transport"
        
    #     config MICROXRCEDDSCLIENT_TRANSPORT_UDP
    #         bool "micro-ROS UDP network transport"
        
    # endchoice

    # config MICROXRCEDDSCLIENT_NODES
    #     string "available micro-ROS nodes"
    #     default "1"

    # config MICROXRCEDDSCLIENT_PUBLISHERS
    #     string "available micro-ROS publishers"
    #     default "1"
    
    # config MICROXRCEDDSCLIENT_SUBSCRIBERS
    #     string "available micro-ROS subscribers"
    #     default "1"

    # config MICROXRCEDDSCLIENT_CLIENTS
    #     string "available micro-ROS service clients"
    #     default "1"

    # config MICROXRCEDDSCLIENT_SERVERS
    #     string "available micro-ROS service servers"
    #     default "1"
        
    # config MICROXRCEDDSCLIENT_RMW_HISTORIC
    #     string "available micro-ROS RMW historic memory"
    #     default "4"
    
    # config MICROXRCEDDSCLIENT_XRCE_DDS_MTU
    #     string "micro-ROS transport MTU"
    #     default "512"
        
    # config MICROXRCEDDSCLIENT_XRCE_DDS_HISTORIC
    #     string "micro-ROS middleware memory slots"
    #     default "4"  

endif
    
```

## examples/microxrceclient_6lowpan/Kconfig
```kconfig
#
# For a description of the syntax of this configuration file,
# see the file kconfig-language.txt in the NuttX tools repository.
#

config EXAMPLES_MICROXRCECLIENT_6LOWPAN
	tristate "Micro-XRCE-DDS Client 6lowpan example"
	default n
	---help---
		Enable Micro-XRCE-DDS 6lowpan Client example

if EXAMPLES_MICROXRCECLIENT_6LOWPAN

config EXAMPLES_MICROXRCECLIENT_6LOWPAN_PROGNAME
	string "Program name"
	default "microxrceclient_6lowpan"
	depends on BUILD_LOADABLE
	---help---
		This is a example which create a Micro-XRCE-DDS 6lowpan publisher that works with the MRF24J40 radio over 6LOWPAN protocol

config EXAMPLES_MICROXRCECLIENT_6LOWPAN_PRIORITY
	int "Micro-XRCE-DDS Client 6lowpan task priority"
	default 100

config EXAMPLES_MICROXRCECLIENT_6LOWPAN_STACKSIZE
	int "Micro-XRCE-DDS Client 6lowpan stack size"
	default 4096

endif
```

## microxrcedds/Kconfig
```kconfig
# Kconfig for Micro XRCE-DDS 

menu "Micro XRCE-DDS"

config MICRO_XRCE_CLIENT
    bool "Enable Micro XRCE-DDS Client"
    default n
    ---help---
        Enable support for Micro XRCE-DDS Client

if MICRO_XRCE_CLIENT

comment "Micro XRCE-DDS Options"

config UXR_BRANCH
        string "Micro XRCE-DDS branch"
        default "master"
        ---help---
            Select branch to clone al build.

config UXR_PROFILE_CREATE_ENTITIES_REF
        bool "Create Entities by Reference profile"
        default y
        ---help---
            Enable the Create Entities by Reference profile.

config UXR_PROFILE_CREATE_ENTITIES_XML
        bool "Create Entities by XML profile"
        default y
        ---help---
            Enable the Create Entities by XML profile.

config UXR_PROFILE_READ_ACCESS
        bool "Read Access profile"
        default y
        ---help---
            Enable Read Acces profile.

config UXR_PROFILE_SERIAL_TRANSPORT 
        bool "Serial Transport profile"
        default y
        ---help---
            Enable the Serial Transport profile.

if UXR_PROFILE_SERIAL_TRANSPORT

config UXR_SERIAL_TRANSPORT_MTU
        int "Serial Transport MTU"
        default 64
        ---help---
            Serial Transport MTU.

endif # UXR_PROFILE_SERIAL_TRANSPORT

config UXR_PROFILE_UDP_TRANSPORT 
        bool "UDP Transport profile"
        default y 
        depends on NET_UDP
        ---help---
            Enable the UDP Transport profile.

if UXR_PROFILE_UDP_TRANSPORT

config UXR_UDP_TRANSPORT_MTU
        int "UDP Transport MTU"
        default 64 
        ---help---
            UDP Transport MTU.

endif # UXR_PROFILE_UDP_TRANSPORT

config UXR_PROFILE_TCP_TRANSPORT 
        bool "TCP Transport profile"
        default y
        depends on NET_TCP
        ---help---
            Enable the TCP Transport profile.

if UXR_PROFILE_TCP_TRANSPORT

config UXR_TCP_TRANSPORT_MTU
        int "TCP Transport MTU"
        default 64 
        ---help---
            TCP Transport MTU.

endif # UXR_PROFILE_TCP_TRANSPORT

config UXR_MAX_OUTPUT_BEST_EFFORT_STREAMS 
        int "Output Best-Effort streams"
        default 1
        ---help---
            Number of Output Best-Effort streams.

config UXR_MAX_OUTPUT_RELIABLE_STREAMS 
        int "Output Reliable streams"
        default 1
        ---help---
            Number of output reliable streams.

config UXR_MAX_INPUT_BEST_EFFORT_STREAMS 
        int "Input Best-Effort streams"
        default 1
        ---help---
            Number of Input Best-Effort streams.

config UXR_MAX_INPUT_RELIABLE_STREAMS 
        int "Input Reliable streams"
        default 1
        ---help---
            Number of Input Reliable streams.

config UXR_MAX_SESSION_CONNECTION_ATTEMPTS
        int "Maximum session connections attempts"
        default 10
        ---help---
            Maximum number of session connections attempts.

config UXR_MIN_SESSION_CONNECTION_INTERVAL
        int "Minimum session connections intermal (ms)"
        default 1
        ---help---
            Minimum session connections internal in milliseconds.

config UXR_MIN_HEARTBEAT_TIME_INTERVAL
        int "Minimum heartbeat time intermal (ms)"
        default 1
        ---help---
            Minimum heartbeat time internal in milliseconds.

config UXR_VERBOSE_OUTPUT
        bool "Enable verbose output"
        default n
        ---help---
            Enable verbose output usefull for debugging.

endif # MICRO_XRCE_CLIENT

endmenu # Micro XRCE-DDS 
```
